/ {
    chosen {
        zmk,keyboard = &kscan0;
    };

    kscan0: kscan {
        compatible = "zmk,kscan-gpio-matrix";

        diode-direction = "col2row";

        row-gpios = <
            &gpio0 24 (GPIO_ACTIVE_HIGH | GPIO_PULL_UP)
            &gpio1 0 (GPIO_ACTIVE_HIGH | GPIO_PULL_UP)
            &gpio0 11 (GPIO_ACTIVE_HIGH | GPIO_PULL_UP)
            &gpio1 4 (GPIO_ACTIVE_HIGH | GPIO_PULL_UP)
            &gpio1 6 (GPIO_ACTIVE_HIGH | GPIO_PULL_UP)
        >;

        col-gpios = <
            &gpio0 29 (GPIO_ACTIVE_HIGH)
            &gpio0 2  (GPIO_ACTIVE_HIGH)
            &gpio1 15 (GPIO_ACTIVE_HIGH)
            &gpio1 13  (GPIO_ACTIVE_HIGH)
            &gpio1 11  (GPIO_ACTIVE_HIGH)
            &gpio0 10 (GPIO_ACTIVE_HIGH)
            &gpio0 9 (GPIO_ACTIVE_HIGH)
        >;
    };
};
